## configs/mt6878_tetris_defconfig
```kconfig
CONFIG_ARM=y
CONFIG_POSITION_INDEPENDENT=y
CONFIG_ARCH_MEDIATEK=y
CONFIG_TEXT_BASE=0x50F00000
CONFIG_SYS_MALLOC_LEN=0x81f000
CONFIG_NR_DRAM_BANKS=32
CONFIG_ENV_SIZE=0x2f000
CONFIG_DM_GPIO=y
CONFIG_DEFAULT_DEVICE_TREE="mt6878-nothing-tetris"
CONFIG_DM_RESET=y
CONFIG_SYS_LOAD_ADDR=0x40000000
CONFIG_IDENT_STRING=" mt6878-tetris"
CONFIG_CC_OPTIMIZE_FOR_SPEED=y
CONFIG_ENV_VARS_UBOOT_CONFIG=y
CONFIG_STACK_SIZE=0x3000000
CONFIG_DYNAMIC_SYS_CLK_FREQ=y
CONFIG_EFI_VARIABLE_NO_STORE=y
CONFIG_ANDROID_BOOT_IMAGE_IGNORE_BLOB_ADDR=y
CONFIG_FIT=y
# CONFIG_EXPO is not set
CONFIG_SUPPORT_RAW_INITRD=y
CONFIG_SHOW_BOOT_PROGRESS=y
CONFIG_OF_STDOUT_VIA_ALIAS=y
CONFIG_FDT_SIMPLEFB=y
CONFIG_USE_PREBOOT=y
CONFIG_DEFAULT_FDT_FILE="mt6878-nothing-tetris"
CONFIG_CONSOLE_RECORD=y
CONFIG_SYS_CBSIZE=2048
CONFIG_SYS_PBSIZE=2052
CONFIG_SYS_CONSOLE_ENV_OVERWRITE=y
# CONFIG_SYS_DEVICE_NULLDEV is not set
CONFIG_LOG=y
CONFIG_LOGF_FILE=y
CONFIG_LOGF_LINE=y
CONFIG_LOGF_FUNC=y
CONFIG_BOARD_TYPES=y
# CONFIG_DISPLAY_CPUINFO is not set
# CONFIG_BOARD_INIT is not set
CONFIG_HUSH_PARSER=y
CONFIG_CMD_UFETCH=y
CONFIG_CMD_BOOTZ=y
CONFIG_CMD_BOOTMENU=y
CONFIG_CMD_ABOOTIMG=y
# CONFIG_CMD_BIND is not set
CONFIG_CMD_CLK=y
CONFIG_CMD_DFU=y
CONFIG_CMD_GPIO=y
CONFIG_CMD_GPIO_READ=y
CONFIG_CMD_MMC=y
CONFIG_CMD_PART=y
CONFIG_CMD_USB=y
CONFIG_CMD_USB_MASS_STORAGE=y
CONFIG_CMD_UMS_ABORT_KEYED=y
CONFIG_CMD_BMP=y
# CONFIG_CMD_CLS is not set
CONFIG_CMD_TIME=y
CONFIG_CMD_PAUSE=y
CONFIG_CMD_BTRFS=y
CONFIG_CMD_EROFS=y
CONFIG_CMD_EXT2=y
CONFIG_CMD_EXT4=y
CONFIG_CMD_EXT4_WRITE=y
CONFIG_CMD_FAT=y
CONFIG_CMD_SQUASHFS=y
CONFIG_CMD_FS_GENERIC=y
CONFIG_CMD_FS_UUID=y
CONFIG_CMD_JFFS2=y
CONFIG_CMD_ZFS=y
# CONFIG_DOS_PARTITION is not set
CONFIG_EFI_PARTITION=y
CONFIG_OF_EMBED=y
CONFIG_ENV_OVERWRITE=y
CONFIG_ENV_RELOC_GD_ENV_ADDR=y
CONFIG_ENV_USE_DEFAULT_ENV_TEXT_FILE=y
CONFIG_ENV_DEFAULT_ENV_TEXT_FILE="board/mediatek/mtk-phone.env"
CONFIG_NO_NET=y
CONFIG_BUTTON=y
CONFIG_BUTTON_REMAP_PHONE_KEYS=y
CONFIG_CLK=y
CONFIG_CLK_CCF=y
CONFIG_DFU_RAM=y
CONFIG_DFU_SCSI=y
CONFIG_SYS_DFU_DATA_BUF_SIZE=0x80000
CONFIG_USB_FUNCTION_FASTBOOT=y
CONFIG_FASTBOOT_BUF_ADDR=0x60000000
CONFIG_FASTBOOT_BUF_SIZE=0x10000000
CONFIG_FASTBOOT_FLASH=y
CONFIG_FASTBOOT_FLASH_BLOCK=y
CONFIG_FASTBOOT_FLASH_BLOCK_INTERFACE_NAME="scsi"
CONFIG_FASTBOOT_FLASH_BLOCK_DEVICE_ID=2
CONFIG_FASTBOOT_OEM_RUN=y
CONFIG_FASTBOOT_CMD_OEM_CONSOLE=y
CONFIG_FASTBOOT_OEM_BOARD=y
CONFIG_GPIO_HOG=y
CONFIG_MMC_MTK=y
CONFIG_PHY=y
CONFIG_PHY_MTK_TPHY=y
CONFIG_PINCTRL=y
CONFIG_PINCTRL_MT6878=y
CONFIG_RESET_TI_SYSCON=y
CONFIG_SCSI=y
CONFIG_BAUDRATE=921600
CONFIG_DEFAULT_ENV_IS_RW=y
# CONFIG_REQUIRE_SERIAL_CONSOLE is not set
CONFIG_DM_SERIAL=y
CONFIG_MTK_SERIAL=y
CONFIG_USB=y
CONFIG_DM_USB_GADGET=y
CONFIG_USB_XHCI_HCD=y
CONFIG_USB_MTU3=y
CONFIG_USB_GADGET=y
CONFIG_USB_FUNCTION_ACM=y
CONFIG_UFS=y
CONFIG_UFS_MEDIATEK=y
CONFIG_VIDEO=y
# CONFIG_VIDEO_FONT_8X16 is not set
CONFIG_VIDEO_FONT_16X32=y
CONFIG_SYS_WHITE_ON_BLACK=y
CONFIG_VIDEO_SIMPLE=y
CONFIG_WDT=y
CONFIG_WDT_MTK=y
```

## configs/tetris_defconfig
```kconfig
CONFIG_ARM=y
CONFIG_SYS_BOARD="tetris"
CONFIG_ARCH_MEDIATEK=y
CONFIG_TEXT_BASE=0x40010000
CONFIG_CUSTOM_SYS_INIT_SP_ADDR=0x4c000000
CONFIG_NR_DRAM_BANKS=1
CONFIG_DEFAULT_DEVICE_TREE="mt6878-nothing-tetris"
CONFIG_TARGET_MT6878=y
CONFIG_IDENT_STRING=" mt6878-tetris"
CONFIG_SYS_LOAD_ADDR=0x44000000
CONFIG_SYS_MALLOC_LEN=0x81f000
CONFIG_DEFAULT_FDT_FILE="mt6878-nothing-tetris"
CONFIG_BAUDRATE=921600
CONFIG_DM_SERIAL=y
CONFIG_MTK_SERIAL=y
CONFIG_DEBUG_UART=y
CONFIG_DEBUG_UART_BASE=0x11001000
CONFIG_DEBUG_UART_SKIP_INIT=y
CONFIG_DEBUG_UART_CLOCK=0x0
```
